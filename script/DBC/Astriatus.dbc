VERSION "1.0"

NS_ :

BS_:

BU_: AMS MC1 MC0 Front Back

BO_ 2 WHEEL_0: 8 Front
 SG_ WHEEL_SPEED_FRONT_LEFT : 0|32@1- (1,0) [-20|60] "rpm" Vector__XXX
 SG_ WHEEL_SPEED_FRONT_RIGHT : 32|32@1- (1,0) [-20|60] "rpm" Vector__XXX

BO_ 3 WHEEL_1: 8 Back
 SG_ WHEEL_SPEED_BACK_LEFT : 0|32@1- (1,0) [-20|60] "rpm" Vector__XXX
 SG_ WHEEL_SPEED_BACK_RIGHT : 32|32@1- (1,0) [-20|60] "rpm" Vector__XXX

BA_DEF_ SG_  "DataType" ENUM  "int","short","byte","float","bool","bin";
BA_DEF_DEF_  "DataType" "int";
BA_ "DataType" SG_ 3 WHEEL_SPEED_BACK_RIGHT 3;
